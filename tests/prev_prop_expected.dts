/dts-v1/;

/ {
        str-prop = "1", "2", "3", "4", "1", "2", "6";
        int-prop = <1 2 3 4 1 2 6>;

        mixed-prop = <1>, "1", <0>, "0";

        subnode {
                str-prop = "1", "2", "3", "4", "1", "2";
                int-prop = <1 2 3 4 1 2>;
        };
};
