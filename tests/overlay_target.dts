/dts-v1/;
/plugin/;

/ {
	fragment@1 {
		target-path = "";
		__overlay__ {
			test-str-property = "1";
		};
	};

	fragment@2 {
		target-path = "sub-test-node";
		__overlay__ {
			test-str-property = "2";
		};
	};
};
